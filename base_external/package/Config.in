## base_external/package/aesd-socketApp/Config.in
```kconfig
config BR2_PACKAGE_AESD_SOCKETAPP
    bool "aesd-socketApp"
    help
        Includes the aesdSocket application
        Used to understand sockets in Linux
```
